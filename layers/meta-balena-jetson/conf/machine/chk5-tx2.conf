## layers/meta-balena-jetson/conf/machine/chk5-tx2.conf
```bitbake
#@TYPE: Machine
##@NAME: chk5-tx2
##@DESCRIPTION: Machine configuration for the Chuck V5

MACHINEOVERRIDES = "jetson-tx2:${MACHINE}"
ODMDATA ?= "0x3090000"
include conf/machine/jetson-tx2.conf
```

## layers/meta-balena-jetson/conf/machine/include/gasket.inc
```bitbake
# Settings for enabling the Gasket kernel module for PCIe-based Coral Edge TPUs

MACHINE_EXTRA_RDEPENDS += "kernel-module-gasket kernel-module-apex"
```

## layers/meta-balena-jetson/conf/machine/j100-tx2.conf
```bitbake
#@TYPE: Machine
##@NAME: j100-tx2
##@DESCRIPTION: Machine configuration for the J100

MACHINEOVERRIDES = "jetson-tx2:${MACHINE}"
include conf/machine/jetson-tx2.conf
```

## layers/meta-balena-jetson/conf/machine/jetson-tx2-6.conf
```bitbake
#@TYPE: Machine
##@NAME: chk5-tx2
##@DESCRIPTION: Machine configuration for the Jetson TX2 with configuration option 6.

MACHINEOVERRIDES = "jetson-tx2:${MACHINE}"
ODMDATA ?= "0x3090000"
include conf/machine/jetson-tx2.conf
```

## layers/meta-resin-jetson/conf/layer.conf
```bitbake
BBPATH .= ":${LAYERDIR}"

BBFILES += "${LAYERDIR}/recipes-*/*/*.bb \
            ${LAYERDIR}/recipes-*/*/*.bbappend"

BBFILE_COLLECTIONS += "resin-jetson"
BBFILE_PATTERN_resin-jetson := "^${LAYERDIR}/"
BBFILE_PRIORITY_resin-jetson = "1337"

GCCVERSION = "6.%"
```

## layers/meta-resin-jetson/conf/machine/cti-orbitty-tx2.conf
```bitbake
#@TYPE: Machine
##@NAME: cti-orbitty-tx2
##@DESCRIPTION: Machine configuration for the NVIDIA Jetson TX2 Orbitty

MACHINEOVERRIDES = "jetson-tx2:${MACHINE}"
include conf/machine/jetson-tx2.conf
```

## layers/meta-resin-jetson/conf/machine/skx2.conf
```bitbake
#@TYPE: Machine
##@NAME: skx2
##@DESCRIPTION: Machine configuration for the SKX2

MACHINEOVERRIDES = "jetson-tx2:${MACHINE}"
include conf/machine/jetson-tx2.conf

PREFERRED_VERSION_linux-tegra = "4.4.38.skx2%"
```
